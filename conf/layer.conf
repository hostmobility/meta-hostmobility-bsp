## conf/layer.conf
```bitbake
# We have a conf and classes directory, append to BBPATH
BBPATH .= ":${LAYERDIR}"

# We have recipes-* directories, add to BBFILES
BBFILES += "${LAYERDIR}/recipes-*/*/*.bb ${LAYERDIR}/recipes-*/*/*.bbappend"

BBFILE_COLLECTIONS += "hostmobility-bsp-layer"
BBFILE_PATTERN_hostmobility-bsp-layer = "^${LAYERDIR}/"
BBFILE_PRIORITY_hostmobility-bsp-layer = "91"

BBFILES_DYNAMIC += "\
  variscite-bsp:${LAYERDIR}/dynamic-layers/variscite-nxp-layer/*/*/*.bbappend \
  toradex-ti-layer:${LAYERDIR}/dynamic-layers/toradex-ti-layer/*/*/*.bbappend \
 "

LAYERDEPENDS_hostmobility-bsp-layer = " \
    core \
"


LAYERSERIES_COMPAT_hostmobility-bsp-layer = "kirkstone"


# meta-variscite-bsp:${LAYERDIR}/recipes*/*/*variscite*"linux-variscite/recipes-*/*/*.bbappend 
```

## conf/machine/imx8mp-var-dart-hmx0.conf
```bitbake
# The HMX0 machine is for testing evaluation boards on the Variscite carrier
# board.

require conf/machine/imx8mp-var-dart.conf
require conf/machine/include/hmx-base.conf

MACHINEOVERRIDES_EXTENDER_imx8mp-var-dart-hmx0 = "imx8mp-var-dart"

KERNEL_DEVICETREE = "freescale/imx8mp-var-dart-hmx0.dtb"
```

## conf/machine/imx8mp-var-dart-hmx1-ml.conf
```bitbake
# eIQ NXP Software framework for i.MX 8M Plus HMX1 Machine configuration

require conf/machine/imx8mp-var-dart-hmx1.conf

MACHINE_FEATURES:append:use-nxp-bsp = " optee jailhouse mrvl8997"

DEFAULTTUNE:mx8m-generic-bsp = "armv8a-crc-crypto"

IMAGE_INSTALL:remove:imx8mp-var-dart-hmx1 = ""
IMAGE_INSTALL:append:imx8mp-var-dart-hmx1 = " packagegroup-imx-isp"
```

## conf/machine/include/hmm-base.conf
```bitbake
BBMASK += "\
    meta-hostmobility-bsp/recipes-bsp/libubootenv \
    meta-hostmobility-bsp/recipes-bsp/u-boot \
    meta-hostmobility-bsp/recipes-kernel/linux \
"

PREFERRED_CONNECTIVITY_MANAGER_PACKAGES = ""
IMAGE_INSTALL:append = " \
    packagegroup-host-monitor-commercial \
"

MACHINE_EXTRA_RDEPENDS:append = " \
    kernel-modules \
    host-watchdog-driver \
    host-watchdog-fw-am62x \
    gpio-modem-controller \
    gpio-overlay-hmm \
"
# Remove files that are devboard-specific and image types we do not use.
IMAGE_CLASSES:remove = "image_type_tezi"
IMAGE_FSTYPES:remove = "teziimg tar.xz wic.xz wic.bmap"

IMAGE_BOOT_FILES:append = "tiboot3.bin tispl.bin u-boot.img"

# Exclude toradex devboard device tree blobs from been installed on the system bootfs.

KERNEL_DEVICETREE:remove = " \
    ${KERNEL_DTB_PREFIX}k3-am625-verdin-nonwifi-dahlia.dtb \
    ${KERNEL_DTB_PREFIX}k3-am625-verdin-nonwifi-mallow.dtb \
    ${KERNEL_DTB_PREFIX}k3-am625-verdin-nonwifi-yavia.dtb \
    ${KERNEL_DTB_PREFIX}k3-am625-verdin-wifi-dahlia.dtb \
    ${KERNEL_DTB_PREFIX}k3-am625-verdin-wifi-mallow.dtb \
    ${KERNEL_DTB_PREFIX}k3-am625-verdin-wifi-yavia.dtb \
"

# Add wic.gz file type support to enable flashing using gzwrite in uboot
IMAGE_FSTYPES:append = " wic.gz"

#Fixup default deploy dir(images) to make it same as our other machines.
TI_COMMON_DEPLOY = "${DEPLOY_DIR}"
```

## conf/machine/include/mx4-extra.inc
```bitbake
PREFERRED_PROVIDER_j1708-lib = "j1708-lib_1.0.6"
PREFERRED_PROVIDER_j1708-test = "j1708-test_1.0.6"

MACHINE_EXTRA_RDEPENDS_append = " \
    kernel-modules \
    ${@bb.utils.contains('LICENSE_FLAGS_WHITELIST', 'closed', \
                          'packagegroup-hostmobility-commercial', '', d)} \
    ${@bb.utils.contains('MACHINE_FEATURES', 'wifi', \
                          'linux-firmware-ath9k linux-firmware-wl18xx hostapd', '', d)} \
    ${@bb.utils.contains('MACHINE_FEATURES', 'flash', \
                          'mtd-utils mtd-utils-ubifs mtd-utils-misc mtd-utils-jffs2', '', d)} \
    ${@bb.utils.contains('MACHINE_FEATURES', 'alsa', \
                          'alsa-utils', '', d)} \
"

MACHINE_EXTRA_RDEPENDS_append_tegra3 = " \
    e2fsprogs-resize2fs \
"

MACHINE_EXTRA_RDEPENDS_append_vf = " \
    usb-suspend-resume \
"

CORE_IMAGE_EXTRA_INSTALL += " \
    kernel-module-pic \
"
```

## conf/machine/include/mx4-tegra-base.inc
```bitbake
# Provides common Tegra SoC settings on MX-4 products

require conf/machine/include/soc-family.inc

EXTRA_IMAGEDEPENDS += "u-boot"

PREFERRED_PROVIDER_virtual/psplash = "psplash-angstrom"
PREFERRED_PROVIDER_psplash-support = "psplash-angstrom"

# Tegra binaries require a specific X-Server binary ABI
PREFERRED_PROVIDER_virtual/xserver_tegra = "xserver-xorg"
PREFERRED_VERSION_xserver-xorg_tegra = "99:1.14%"
XSERVER = "xserver-xorg \
           xf86-input-evdev \
           xf86-input-mouse \
           xf86-video-fbdev \
           xf86-input-keyboard"

PREFERRED_PROVIDER_virtual/kernel = "linux-hostmobility"

KERNEL_IMAGETYPE = "uImage"

# The kernel lives in a seperate FAT or UBI partition, don't deploy it in /boot
RDEPENDS_kernel-base = ""

PREFERRED_PROVIDER_u-boot = "u-boot-hostmobility"
PREFERRED_PROVIDER_virtual/bootloader = "u-boot-hostmobility"
PREFERRED_PROVIDER_u-boot-fw-utils ?= "u-boot-hostmobility-fw-utils"

PREFERRED_PROVIDER_lxde-icon-theme = "lxde-icon-theme"
PREFERRED_PROVIDER_lxsession-lite = "lxsession"
PREFERRED_PROVIDER_virtual/psplash = "psplash-angstrom"
PREFERRED_PROVIDER_psplash-support = "psplash-angstrom"

PREFERRED_PROVIDER_virtual/mesa = "mesa"
PREFERRED_PROVIDER_virtual/egl = "tdx-nv-binaries"
PREFERRED_PROVIDER_virtual/libgles1 = "tdx-nv-binaries"
PREFERRED_PROVIDER_virtual/libgles2 = "tdx-nv-binaries"

# Install NV binaries which contains tegra X-Server drivers when X11 is chosen
MACHINE_EXTRA_RRECOMMENDS_append_tegra = " ${@bb.utils.contains('DISTRO_FEATURES', 'x11', 'tdx-nv-binaries', '', d)}"

# used by sysvinit_2
SERIAL_CONSOLE = "115200 ttyS0"

IMAGE_FSTYPES ?= "tar.xz"
```

## conf/machine/include/mx4-tegra2-base.inc
```bitbake
# Provides common Tegra2 SoC settings on MX-4 products

MACHINEOVERRIDES =. "tegra:tegra2:"

UBOOT_ENTRYPOINT = "0x00008000"

IMAGE_FSTYPES:append = " ubifs"

# Enable free --space-fixup (-F) by default
MKUBIFS_ARGS = " -c 4084 -e 248KiB -m 4KiB -F"
UBINIZE_ARGS = " -p 256KiB -m 4KiB -s 4KiB"
UBI_VOLNAME = "rootfs"

# T20 does not have neon
DEFAULTTUNE = "armv7athf"
#choose a specific vfp, or we end up with the default vfpv2 optimization
TUNE_CCARGS += "-mfpu=vfpv3-d16"
require conf/machine/include/tune-cortexa9.inc
```

## conf/machine/include/mx4-tegra3-base.inc
```bitbake
# Provides common Tegra3 SoC settings on MX-4 products

MACHINEOVERRIDES =. "tegra:tegra3:tegra3mainline:"
MACHINEOVERRIDES =. "use-head-next:"

# meta-angstrom/conf/distro/include/arm-defaults.inc
require conf/machine/include/soc-family.inc

DEFAULTTUNE = "armv7athf-neon"
require conf/machine/include/tune-cortexa9.inc

#disable build uboot for now.
#EXTRA_IMAGEDEPENDS += "u-boot"

PREFERRED_PROVIDER_virtual/kernel = "linux-hostmobility"

KERNEL_IMAGETYPE = "uImage"

# The kernel lives in a seperate FAT or UBI partition, don't deploy it in /boot
RDEPENDS_kernel-base = ""

PREFERRED_PROVIDER_u-boot = "u-boot-hostmobility"
PREFERRED_PROVIDER_virtual/bootloader = "u-boot-hostmobility"
PREFERRED_PROVIDER_u-boot-fw-utils ?= "u-boot-hostmobility-fw-utils"

# used by sysvinit_2
SERIAL_CONSOLE = "115200 ttyS0"

IMAGE_FSTYPES ?= "ext3"
# Set ext3 partition arguments -b 4096 -g 32768 to allow faster reflashing of the system when using t30_hmupdate file in /boot on target machine.
EXTRA_IMAGECMD_ext3 = "-b 4096 -g 32768 "

BBMASK += "recipes-bsp/u-boot/u-boot-hostmobility_2019.04.bb"

# wic support
#WKS_FILE = "sdimage-bootpart-mx4-t30.wks"
#WIC_CREATE_EXTRA_ARGS_append = " --no-fstab-update"

IMAGE_BOOT_FILES ?= " \
    ${KERNEL_IMAGETYPE} \
    ${KERNEL_DEVICETREE} \
"
WKS_FILE_DEPENDS ?= " \
   virtual/bootloader \
    \
    e2fsprogs-native \
    bmap-tools-native \
"
```

## conf/machine/include/mx4-vf-base.inc
```bitbake
# Provides common settings among MX-4 products that use Colibri VF61 COM

include conf/machine/include/imx-base.inc
include conf/machine/include/arm/armv7a/tune-cortexa5.inc

MACHINEOVERRIDES =. "vf:vf50:vf60:vfcv61:"

LINUX_VERSION_use-head-next = "6.1"
PREFERRED_PROVIDER_virtual/kernel ?= "linux-hostmobility"
KERNEL_DEFCONFIG = "imx_v6_v7_defconfig"
KERNEL_IMAGETYPE = "zImage"

# We store kernel on seperate MTD partition so no need to deploy to rootfs.
RDEPENDS:${KERNEL_PACKAGE_NAME}-base = ""

PREFERRED_PROVIDER_u-boot ?= "u-boot-hostmobility"
PREFERRED_PROVIDER_virtual/bootloader ?= "u-boot-hostmobility"
#PREFERRED_PROVIDER_u-boot-fw-utils ?= "u-boot-hostmobility-fw-utils"

# U-Boot NAND binary includes 0x400 padding required for NAND boot
UBOOT_BINARY ?= "u-boot-nand.imx"
UBOOT_MAKE_TARGET = "u-boot-nand.imx"

#disable build uboot for now.
#EXTRA_IMAGEDEPENDS += "u-boot"

IMAGE_FSTYPES = "tar.xz ubifs"

# Enable free --space-fixup (-F) by default, this allows DFU updates
MKUBIFS_ARGS = " -c 8112 -e 124KiB -m 2KiB -F"
UBINIZE_ARGS = " -p 128KiB -m 2048 -s 2048"
UBI_VOLNAME = "rootfs"

SERIAL_CONSOLE ?= "115200 ttyLP0"


PREFERRED_PROVIDER_j1708-lib = "j1708-lib_1.0.6"
PREFERRED_PROVIDER_j1708-test = "j1708-test_1.0.6"

MACHINE_EXTRA_RDEPENDS += " \
    kernel-modules \
    packagegroup-hostmobility-commercial \
    ${@bb.utils.contains('MACHINE_FEATURES', 'wifi', \
                          'linux-firmware-ath9k linux-firmware-wl18xx hostapd', '', d)} \
    ${@bb.utils.contains('MACHINE_FEATURES', 'flash', \
                          'mtd-utils mtd-utils-ubifs mtd-utils-misc mtd-utils-jffs2', '', d)} \
    ${@bb.utils.contains('MACHINE_FEATURES', 'alsa', \
                          'alsa-utils', '', d)} \
    libubootenv \
"

CORE_IMAGE_EXTRA_INSTALL += " \
    kernel-module-pic \
"


BBMASK += "recipes-bsp/u-boot/u-boot-hostmobility_2019.04.bb"

BBMASK +=  "recipes-multimedia/gstreamer/"
BBMASK +=  "recipes-core/fs-init/fs-init.bbappend"

BBMASK:imx-mainline-bsp = "meta-imx/"
```

## conf/machine/include/mx5-base.inc
```bitbake
# Provides common settings among MX-5 products that use imx6

MACHINEOVERRIDES =. "mx6:mx6q:mx6dl:"

IMX_DEFAULT_BSP = "nxp"

require conf/machine/include/imx-base.inc
require conf/machine/include/tune-cortexa9.inc

KERNEL_IMAGETYPE = "zImage"
PREFERRED_PROVIDER_virtual/kernel = "linux-mobility-imx"

# We store kernel on seperate MTD partition so no need to deploy to rootfs.
RDEPENDS_${KERNEL_PACKAGE_NAME}-base = ""

PREFERRED_PROVIDER_u-boot = "u-boot-hostmobility"
PREFERRED_PROVIDER_virtual/bootloader = "u-boot-hostmobility"
PREFERRED_PROVIDER_u-boot-fw-utils ?= "libubootenv"

UBOOT_BINARY = "u-boot-dtb.imx"
UBOOT_MAKE_TARGET = "all"

IMAGE_FSTYPES = "wic.gz tar.xz"
# wic support
WKS_FILE = "hm-mx5-uboot.wks.in"
WIC_CREATE_EXTRA_ARGS_append = " --no-fstab-update"

UBOOT_ENTRYPOINT = "0x82008000"
UBOOT_LOADADDRESS = "${UBOOT_ENTRYPOINT}"

SERIAL_CONSOLE ?= "115200 ttyLP0"

MACHINE_EXTRA_RDEPENDS_append = " \
    kernel-modules \
    e2fsprogs-resize2fs \
    packagegroup-hostmobility-commercial-mx5 \
    ${@bb.utils.contains('MACHINE_FEATURES', 'wifi', \
                          'linux-firmware-sd8897 hostapd', '', d)} \
"

KERNEL_MODULE_AUTOLOAD += "cryptodev-module"
# fix u-boot-fw-utils \ using libubootenv if we need fw_setenv?


BBMASK +=  "recipes-core/fs-init/fs-init.bbappend"
BBMASK +=  "recipes-core/usb-rndis-systemd/usb-rndis-systemd.bbappend"
BBMASK += "recipes-connectivity/iproute2/iproute2_3.15.0.bb"
```

## conf/machine/include/mxv-base.inc
```bitbake
# Provides common settings among MX-5 products that use imx6

MACHINEOVERRIDES =. "mx6:mx6q:mx6dl:mxv-base:"

IMX_DEFAULT_BSP = "nxp"

include conf/machine/include/imx-base.inc
require conf/machine/include/arm/armv7a/tune-cortexa9.inc

KERNEL_IMAGETYPE = "zImage"
PREFERRED_PROVIDER_virtual/kernel = "linux-mobility-imx"

# We store kernel on seperate MTD partition so no need to deploy to rootfs.
RDEPENDS:${KERNEL_PACKAGE_NAME}-base = ""

PREFERRED_PROVIDER_u-boot = "u-boot-hostmobility"
PREFERRED_PROVIDER_virtual/bootloader = "u-boot-hostmobility"
PREFERRED_PROVIDER_u-boot-fw-utils ?= "libubootenv"
PREFERRED_PROVIDER_j1708-lib = "j1708-lib_2.0.0"
PREFERRED_PROVIDER_j1708-test = "j1708-test_2.0.0"

UBOOT_BINARY ?= "u-boot-dtb.${UBOOT_SUFFIX}"
UBOOT_MAKE_TARGET = "all"

IMAGE_FSTYPES = "wic.gz tar.xz"
# wic support
WKS_FILE = "hm-mx5-uboot.wks.in"
WIC_CREATE_EXTRA_ARGS:append = " --no-fstab-update"

UBOOT_ENTRYPOINT = "0x82008000"
UBOOT_LOADADDRESS = "${UBOOT_ENTRYPOINT}"

SERIAL_CONSOLE ?= "115200 ttyLP0"

MACHINE_EXTRA_RDEPENDS:append = " \
    kernel-modules \
    e2fsprogs-resize2fs \
    packagegroup-hostmobility-commercial-mx5 \
    ${@bb.utils.contains('MACHINE_FEATURES', 'wifi', \
                          'linux-firmware-sd8887 linux-firmware-sd8897 hostapd', '', d)} \
    cryptodev-module \
    cryptodev-tests \
    libubootenv \
"

KERNEL_MODULE_AUTOLOAD += "cryptodev"
# fix u-boot-fw-utils \ using libubootenv if we need fw_setenv?

#BBMASK += "recipes-kernel/kernel-modules/kernel-module-imx-gpu-viv"
```

## conf/machine/mx4-c61-rio.conf
```bitbake
include conf/machine/include/mx4-vf-base.inc

MACHINEOVERRIDES_EXTENDER:mx4-c61-rio = "mx4-c61"

KERNEL_DEVICETREE = "vf610-mx4-c61.dtb"

MACHINE_FEATURES += "usbgadget usbhost vfat rtc serial alsa j1708 flash"

IMAGE_INSTALL:append = " gpio-firecrest-driver"

MX4_PIC_APP = "c61"
MX4_PIC_BOOTLOADER = "c61"
MX4_PIC_BACKUPAPP = "v61"
```

## conf/machine/mx4-c61.conf
```bitbake
#@TYPE: Machine
#@NAME: Host Mobility MX-4 C61
#@SOC: VF500/VF610
#@DESCRIPTION: Machine configuration for Host Mobility MX-4 C61 power by Toradex Colibri VF50/VF61 powered by Freescale Vybrid SoC
#@MAINTAINER: Mirza Krak <mirza.krak@hostmobility.com>

include conf/machine/include/mx4-vf-base.inc

KERNEL_DEVICETREE = "vf610m4-colibri.dtb"

UBOOT_MACHINE ?= "mx4_c61_defconfig"

MACHINE_FEATURES += "usbgadget usbhost vfat rtc serial alsa flash"


MX4_PIC_APP = "c61"
MX4_PIC_BOOTLOADER = "c61"
MX4_PIC_BACKUPAPP = "v61"

BBMASK +=  "recipes-bsp/u-boot/u-boot-variscite.bbappend"
BBMASK +=  "recipes-kernel/linux/linux-variscite_%.bbappend"
```

## conf/machine/mx4-ct.conf
```bitbake
#@TYPE: Machine
#@NAME: mx4_ct
#@DESCRIPTION: Host Mobility MX-4 CT

require conf/machine/include/mx4-tegra-base.inc
require conf/machine/include/mx4-tegra2-base.inc

#UBOOT_MACHINE = "mx4_ct_defconfig" temporary use t20_defconfig...
UBOOT_MACHINE = "mx4_t20_defconfig"
KERNEL_DEFCONFIG = "mx4_ct_defconfig"

MACHINE_FEATURES = "screen touchscreen usbgadget usbhost vfat ext2 alsa wifi bluetooth 3g rtc j1708 flash"

require conf/machine/include/mx4-extra.inc

# from list https://github.dev/hostmobility/mx4/t20/setup_env.sh row36 to 100
MX4_PIC_APP = "ct"
MX4_PIC_BOOTLOADER = "vcc"
MX4_PIC_BACKUPAPP = "vcc"

PREFERRED_PROVIDER_j1708-lib = "j1708-lib_1.0.6"
PREFERRED_PROVIDER_j1708-test = "j1708-test_1.0.6"
```

## conf/machine/mx4-gtt.conf
```bitbake
#@TYPE: Machine
#@NAME: mx4_gtt
#@DESCRIPTION: Host Mobility MX-4 GTT

require conf/machine/include/mx4-tegra-base.inc
require conf/machine/include/mx4-tegra2-base.inc

UBOOT_MACHINE = "mx4_t20_defconfig"
KERNEL_DEFCONFIG ?= "mx4_gtt_defconfig"

MACHINE_FEATURES = "screen touchscreen usbgadget usbhost vfat ext2 alsa wifi bluetooth 3g rtc j1708 flash"

require conf/machine/include/mx4-extra.inc
```
