## conf/machine/mx4-hostcom.conf
```bitbake
#@TYPE: Machine
#@NAME: Host Mobility Host Com based on MX-4 C61
#@SOC: VF500/VF610

include conf/machine/include/imx-base.inc
include conf/machine/include/tune-cortexa5.inc

MACHINEOVERRIDES =. "vf:vf50:vf60:"

KERNEL_DEVICETREE = "vf610-mx4-hostcom.dtb"

UBOOT_MACHINE ?= "mx4_c61_defconfig"

MACHINE_FEATURES += "usbgadget usbhost vfat rtc j1708 flash"

MX4_PIC_APP = "c61"
MX4_PIC_BOOTLOADER = "c61"
MX4_PIC_BACKUPAPP = "v61"

LINUX_VERSION_use-head-next = "4.19"
PREFERRED_PROVIDER_virtual/kernel ?= "linux-hostmobility-vf"
KERNEL_IMAGETYPE = "zImage"

# We store kernel on seperate MTD partition so no need to deploy to rootfs.
RDEPENDS_kernel-base = ""

PREFERRED_PROVIDER_u-boot ?= "u-boot-hostmobility"
PREFERRED_PROVIDER_virtual/bootloader ?= "u-boot-hostmobility"
PREFERRED_PROVIDER_u-boot-fw-utils ?= "u-boot-hostmobility-fw-utils"

# U-Boot NAND binary includes 0x400 padding required for NAND boot
UBOOT_BINARY ?= "u-boot-nand.imx"
UBOOT_MAKE_TARGET = "u-boot-nand.imx"

#EXTRA_IMAGEDEPENDS += "u-boot"

IMAGE_FSTYPES = "tar.xz ubifs"

# Enable free --space-fixup (-F) by default, this allows DFU updates
MKUBIFS_ARGS = " -c 8112 -e 124KiB -m 2KiB -F"
UBINIZE_ARGS = " -p 128KiB -m 2048 -s 2048"
UBI_VOLNAME = "rootfs"

SERIAL_CONSOLE ?= "115200 ttyLP1"

BBMASK += "recipes-bsp/u-boot/u-boot-hostmobility_2019.04.bb"

BBMASK +=  "recipes-multimedia/gstreamer/"
BBMASK +=  "recipes-core/fs-init/fs-init.bbappend"
BBMASK +=  "recipes-core/usb-rndis-systemd"
BBMASK += "recipes-connectivity/iproute2/iproute2_3.15.0.bb"
```

## conf/machine/mx4-mil.conf
```bitbake
#@TYPE: Machine
#@NAME: mx4_mil
#@DESCRIPTION: Host Mobility MX-4 MIL

require conf/machine/include/mx4-tegra-base.inc
require conf/machine/include/mx4-tegra2-base.inc

UBOOT_MACHINE = "mx4_mil_defconfig"
KERNEL_DEFCONFIG ?= "mx4_mil_defconfig"

MACHINE_FEATURES = "usbgadget usbhost vfat ext2 kline flash"

require conf/machine/include/mx4-extra.inc
```

## conf/machine/mx4-t20.conf
```bitbake
#@TYPE: Machine
#@NAME: mx4_t20
#@DESCRIPTION: Host Mobility MX-4 T20

require conf/machine/include/mx4-tegra-base.inc
require conf/machine/include/mx4-tegra2-base.inc

UBOOT_MACHINE = "mx4_t20_defconfig"
KERNEL_DEFCONFIG ?= "mx4_t20_defconfig"

MACHINE_FEATURES = "usbgadget usbhost vfat ext2 alsa wifi bluetooth 3g rtc flash"

require conf/machine/include/mx4-extra.inc
```

## conf/machine/mx4-t30-fr.conf
```bitbake
#@TYPE: Machine
#@NAME: mx4_t30fr
#@DESCRIPTION: Host Mobility MX-4 T30 fr (flexray and wilink8) TODO fix features, (wifi) and flexray..

require conf/machine/include/mx4-tegra-base.inc
require conf/machine/include/mx4-tegra3-base.inc

UBOOT_MACHINE = "mx4_t30_defconfig"
KERNEL_DEFCONFIG ?= "mx4_t30_defconfig"

PREFERRED_RPROVIDER_wpa-supplicant-cli ?= "wpa-supplicant-wl18xx"
PREFERRED_RPROVIDER_wpa-supplicant-passphrase ?= "wpa-supplicant-wl18xx"
PREFERRED_RPROVIDER_wpa-supplicant ?= "wpa-supplicant-wl18xx"
PREFERRED_RPROVIDER_hostap ?= "hostap-deamon-wl18xx"

MACHINE_FEATURES = "usbgadget usbhost vfat ext2 alsa 3g rtc "

require conf/machine/include/mx4-extra.inc
```

## conf/machine/mx4-t30.conf
```bitbake
#@TYPE: Machine
#@NAME: mx4_t30
#@DESCRIPTION: Host Mobility MX-4 T30

include conf/machine/include/mx4-tegra3-base.inc

UBOOT_MACHINE = "mx4_t30_defconfig"

KERNEL_DEVICETREE = "tegra30-mx4-t30.dtb"
KERNEL_DTB_NAME = "tegra3mainline"

UBOOT_ENTRYPOINT = "0x80008000"
UBOOT_LOADADDRESS = "${UBOOT_ENTRYPOINT}"
KERNEL_EXTRA_ARGS += " LOADADDR=0x80008000 "

PREFERRED_RPROVIDER_wpa-supplicant-cli ?= "wpa-supplicant"
PREFERRED_RPROVIDER_wpa-supplicant-passphrase ?= "wpa-supplicant"
PREFERRED_RPROVIDER_wpa-supplicant ?= "wpa-supplicant"
PREFERRED_RPROVIDER_hostapd ?= "hostapd"

MACHINE_FEATURES = "usbgadget usbhost vfat ext2 alsa wifi 3g rtc lin flexray"

MX4_PIC_APP = "t30-fr"
MX4_PIC_BOOTLOADER = "t20"
MX4_PIC_BACKUPAPP = "t20"
```

## conf/machine/mx4-v61.conf
```bitbake
#@TYPE: Machine
#@NAME: Host Mobility MX-4 V61
#@SOC: VF500/VF610
#@DESCRIPTION: Machine configuration for Host Mobility MX-4 V61 powered by Toradex Colibri VF50/VF61 powered by Freescale Vybrid SoC
#@MAINTAINER: Mirza Krak <mirza.krak@hostmobility.com>

include conf/machine/include/mx4-vf-base.inc

KERNEL_DEVICETREE = "vf610-mx4-v61.dtb"

UBOOT_MACHINE ?= "mx4_v61_defconfig"

MACHINE_FEATURES += "usbgadget usbhost vfat rtc flash"

require conf/machine/include/mx4-extra.inc
```

## conf/machine/mx4-vcc.conf
```bitbake
#@TYPE: Machine
#@NAME: mx4_vcc
#@DESCRIPTION: Host Mobility MX-4 VCC

require conf/machine/include/mx4-tegra-base.inc
require conf/machine/include/mx4-tegra2-base.inc

UBOOT_MACHINE = "mx4_vcc_defconfig"

MACHINE_FEATURES = "screen touchscreen usbgadget usbhost vfat ext2 alsa wifi bluetooth 3g rtc"
```

## conf/machine/mx5-pt.conf
```bitbake
#@TYPE: Machine
#@NAME: Host Mobility MX-V PT
#@SOC: iMx6
#@DESCRIPTION: Machine configuration for Host Mobility MX-V PT

include conf/machine/include/mxv-base.inc

KERNEL_DEVICETREE = "imx6qp-mx5.dtb"

PREFERRED_PROVIDER_virtual/kernel = "linux-fslc-lts"

UBOOT_MACHINE ?= "mx5_imx6qp_defconfig"

##UBOOT_MAKE_TARGET = "all"
UBOOT_SUFFIX = "img"
SPL_BINARY = "SPL"
IMAGE_BOOT_FILES = "zImage imx6qp-mx5.dtb"

MACHINE_FEATURES += "usbgadget usbhost vfat rtc wifi alsa j1708 hm-cocpu_updater hm-cocpu_updater-service"

# Use a custom hostname
hostname:pn-base-files = "mxv-pt"
```

## conf/machine/verdin-am62-hmm-k3r5.conf
```bitbake
#@TYPE: Machine
#@NAME: Host monitor mini board using Toradex Verdin AM62 module
#@DESCRIPTION: Machine configuration for Toradex Verdin AM62 SoM

require conf/machine/include/hmm-base.conf
include conf/machine/verdin-am62-k3r5.conf

MACHINEOVERRIDES_EXTENDER:verdin-am62-hmm = "verdin-am62"
```

## conf/machine/verdin-am62-hmm.conf
```bitbake
#@TYPE: Machine
#@NAME: Host monitor mini board using Toradex Verdin AM62 module
#@DESCRIPTION: Machine configuration for Toradex Verdin AM62 SoM

include conf/machine/verdin-am62.conf
require conf/machine/include/hmm-base.conf

MACHINEOVERRIDES_EXTENDER:verdin-am62-hmm = "verdin-am62"

MACHINE_FEATURES = "usbgadget usbhost vfat bluetooth wifi rtc qemu-usermode quectel_modem"

KERNEL_DEVICETREE:append = "ti/k3-am625-verdin-wifi-hmm.dtb"

KBUILD_DEFCONFIG = "defconfig"

# Ignore overlay for hdmi and spidev
TEZI_EXTERNAL_KERNEL_DEVICETREE_BOOT = ""
TEZI_EXTERNAL_KERNEL_DEVICETREE_BOOT:upstream = ""
```
